## config/boards/shields/Kconfig.defconfig
```kconfig
if SHIELD_NUMKEY_LEFT

config ZMK_KEYBOARD_NAME
    default "numkey"

config ZMK_SPLIT_ROLE_CENTRAL
    default y

endif

if SHIELD_NUMKEY_LEFT || SHIELD_NUMKEY_RIGHT

    config ZMK_SPLIT
        default y

endif
```

## config/boards/shields/numkey/Kconfig.defconfig
```kconfig
if SHIELD_NUMKEY_LEFT

config ZMK_KEYBOARD_NAME
    default "NumKey"

config ZMK_SPLIT_ROLE_CENTRAL
    default y

endif

if SHIELD_NUMKEY_LEFT || SHIELD_NUMKEY_RIGHT

    config ZMK_SPLIT
        default y

endif
```
